/dts-v1/;
/plugin/;

// compile with 'make dtoverlay' or use the dtc command:
// dtc -@ -I dts -O dtb -o lidarlite-bbb.dtbo lidarlite-bbb.dts

/ {
    // We could restrict this DT overlay to only RPI or BBB but I see no reason
    // the GPS can't run on any Linux device with an I2C bus.
    compatible = "ti,beaglebone", "ti,beaglebone-black", "ti,beaglebone-green";
    part-number = "lidarlite-bbb";
    version = "00A0";


    fragment@0 {
        target = <&i2c2>;
        __overlay__ {
            #address-cells = <1>;
            #size-cells = <0>;
            lidarlite: lidarlite@62 {
                compatible = "pulsedlight,lidar-lite-v2";
                reg = <0x62>;
            };
        };
    };
};

